#include "LCD12864.h"

/****************************************************************************
函数功能:LCD延时程序
入口参数:t
出口参数:
****************************************************************************/
void LCDdelay(unsigned int t)
{
	unsigned int i,j;
	for(i=0;i<t;i++);
	for(j=0;j<10;j++);
}
/****************************************************************************
状态检查，LCD是否忙
*****************************************************************************/
void CheckState()		
{
   unsigned char dat,DATA;//状态信息（判断是否忙）
   RS=0; // 数据\指令选择，D/I（RS）="L" ，表示 DB7∽DB0 为显示指令数据 
   RW=1; //R/W="H" ，E="H"数据被读到DB7∽DB0 
   do
   {
     DATA=0x00;
     EN=1;	//EN下降源
	   LCDdelay(2);//延时
	   dat=DATA;
     EN=0;
     dat=0x80 & dat; //仅当第7位为0时才可操作(判别busy信号)
    }
    while(!(dat==0x00));
}
/*****************************************************************************
函数功能:写命令到LCD程序，RS(DI)=L,RW=L,EN=H，即来一个脉冲写一次
入口参数:cmdcode
出口参数:
*****************************************************************************/
void write_com(unsigned char cmdcode)
{
  CheckState();//检测LCD是否忙
	RS=0;
	RW=0;
	data_ora=cmdcode;		
	LCDdelay(2);
	EN=1;
	LCDdelay(2);
	EN=0;
}
/*****************************************************************************
函数功能:LCD初始化程序
入口参数:
出口参数:
*****************************************************************************/
void init_lcd()
{
	LCDdelay(100);	
	CS1=1;//刚开始关闭两屏
	CS2=1;
	LCDdelay(100);
	write_com(LCDRSsp_Off);	 //写初始化命令
	write_com(Page_Add+0);
	write_com(Start_Line+0);
	write_com(LCDCol_Add+0);
	write_com(LCDRSsp_On);
}
/*****************************************************************************
函数功能:写数据到LCD程序，RS(DI)=H,RW=L,EN=H，即来一个脉冲写一次
入口参数:RSspdata
出口参数:
*****************************************************************************/
void write_data(unsigned char RSspdata)
{
 CheckState();//检测LCD是否忙
	RS=1;
	RW=0;
	data_ora=RSspdata;
	LCDdelay(2);
	EN=1;
	LCDdelay(2);
	EN=0;
}
/*****************************************************************************
函数功能:清除LCD内存程序
入口参数:pag,col,hzk
出口参数:
*****************************************************************************/
void Clr_Scr()
{
	unsigned char j,k;
	CS1=0; //左、右屏均开显示
	CS2=0;
 	write_com(Page_Add+0);
 	write_com(LCDCol_Add+0);
 	for(k=0;k<8;k++)//控制页数0-7，共8页
 	{
		write_com(Page_Add+k); //每页每页进行写
  		for(j=0;j<64;j++)  //每页最多可写32个中文文字或64个ASCII字符
		{
      		write_com(LCDCol_Add+j);
			write_data(0x00);//控制列数0-63，共64列，写点内容，列地址自动加1
		}
	}
}
/*****************************************************************************
函数功能:地址写入函数
入口参数:x,y
出口参数:
*****************************************************************************/
void LCD_Write_X_Y(unsigned char x,unsigned char y)
{
          y=y&0x7f;                   //限定范围，列不能超过128
          x=x&0x07;                   //限定范围，行不能超过8
          if(y<64)                    //如果列小于64
          {
             CS1=0;             //选通左半屏
             CS2=1;             //关闭右半屏
             write_com(LCDCol_Add+y);  //将列地址写入  
          }
          else
          {
             CS1=1;             //关闭左半屏
             CS2=0;            //选通右半屏
             y&=LCDRSsp_On;
             write_com(LCDCol_Add+y);  //将列地址写入         
          }
          write_com(Page_Add+x);      //将行地址写入        
}
/*****************************************************************************
函数功能:指定位置写16*16字符函数
入口参数:x,y,z,*dat
出口参数:
*****************************************************************************/
void LCD_Write_Chinese(unsigned char x,unsigned char y, unsigned char hz,unsigned char *dat)
{
          unsigned char i=0;        
          LCD_Write_X_Y(x,y);             //设定起始地址
          for(i=0;i<16;i++)
          write_data(dat[hz*32+i]);    //先写上半个字，共16个字节
          LCD_Write_X_Y(x+1,y);        //设定起始地址，此次将行地址加1，以便写下行
          for(i=0;i<16;i++)
          write_data(dat[hz*32+16+i]); //再写下半个字，共16个字节
}  

/*****************************************************************************
函数功能:指定位置写8*16字符函数
入口参数:x,y,z,*dat
出口参数:
*****************************************************************************/
void LCD_Write_Num(unsigned char x,unsigned char y, unsigned char en,unsigned char *dat)
{
    unsigned char i=0;        
    LCD_Write_X_Y(x,y);            //设定起始地址
    for(i=0;i<8;i++)
    write_data(dat[en*16+i]);   //先写上半个字，共8个字节
    LCD_Write_X_Y(x+1,y);          //设定起始地址，此次将行地址加1，以便写下行
    for(i=0;i<8;i++)
    write_data(dat[en*16+8+i]); //再写下半个字，共8个字节
}